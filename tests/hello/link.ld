/* link.ld —— 阶段一裸机程序的链接脚本
 *
 * 裸机环境没有操作系统、没有加载器，所以链接时需要人为指定三件事：
 *   1. 目标架构（OUTPUT_ARCH）与入口符号（ENTRY）；
 *   2. 各段放在哪个地址开始（这里是 0x80000000，与 CONFIG_MBASE 一致）；
 *   3. 段的顺序：代码 -> 只读数据 -> 已初始化数据 -> 未初始化数据。
 *
 * 为什么段顺序重要：objcopy -O binary 生成的扁平镜像按地址从低到高排列，
 * 只会包含"有内容"的段（.text/.rodata/.data），.bss 不占文件空间，
 * 运行时由代码自己当普通内存用。
 */
OUTPUT_ARCH(riscv)
ENTRY(_start)              /* 入口就是 hello.c / vadd.c 里的 _start */

SECTIONS
{
  . = 0x80000000;          /* 镜像起点：也是处理器复位后的取指地址 */
  .text   : { *(.text*) }   /* 代码 */
  .rodata : { *(.rodata*) } /* 只读数据：字符串、常量数组都在这里 */
  .data   : { *(.data*) }   /* 已初始化且可写的数据 */
  .bss    : { *(.bss*) *(COMMON) }  /* 未初始化数据，不进入扁平镜像 */
}
